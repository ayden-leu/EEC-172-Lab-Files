/**
 * @cliArgs --device "CC3200" --package "Default" --part "Default"
 * @versions {"tool":"1.15.0+2826"}
 */

/**
 * These are the peripherals and settings in this configuration
 */
const iGPIO1          = scripting.addPeripheral("GPIO");
iGPIO1.$name          = "MyGPIO0";
iGPIO1.GPIO00.$used   = false;
iGPIO1.GPIO01.$used   = false;
iGPIO1.GPIO02.$used   = false;
iGPIO1.GPIO03.$used   = false;
iGPIO1.GPIO04.$used   = false;
iGPIO1.GPIO05.$used   = false;
iGPIO1.GPIO06.io      = "output";
iGPIO1.GPIO06.$assign = "ball.61";
iGPIO1.GPIO07.$used   = false;
iGPIO1.GPIO08.$used   = false;
iGPIO1.GPIO09.$used   = false;
iGPIO1.GPIO10.$used   = false;
iGPIO1.GPIO11.$used   = false;
iGPIO1.GPIO12.$used   = false;
iGPIO1.GPIO13.$used   = false;
iGPIO1.GPIO14.$used   = false;
iGPIO1.GPIO15.$used   = false;
iGPIO1.GPIO16.$used   = false;
iGPIO1.GPIO17.$used   = false;
iGPIO1.GPIO22.io      = "output";
iGPIO1.GPIO22.$assign = "ball.15";
iGPIO1.GPIO23.$used   = false;
iGPIO1.GPIO24.$used   = false;
iGPIO1.GPIO28.$assign = "ball.18";
iGPIO1.GPIO29.$used   = false;
iGPIO1.GPIO25.$used   = false;
iGPIO1.GPIO30.$used   = false;
iGPIO1.GPIO31.io      = "output";
iGPIO1.GPIO31.$assign = "ball.45";
iGPIO1.GPIO32.$used   = false;
const iI2C1           = scripting.addPeripheral("I2C");
iI2C1.$name           = "MyI2C1";
const iSPI1           = scripting.addPeripheral("SPI");
iSPI1.$name           = "MySPI1";
iSPI1.CS.$used        = false;
iSPI1.CLK.$assign     = "ball.5";
iSPI1.MISO.$used      = false;
iSPI1.MOSI.$assign    = "ball.7";
const iUART1          = scripting.addPeripheral("UART");
iUART1.$name          = "MyUART0";
iUART1.$assign        = "UART0";
iUART1.RTS.$used      = false;
iUART1.CTS.$used      = false;
const iUART2          = scripting.addPeripheral("UART");
iUART2.$name          = "MyUART1";
iUART2.RTS.$used      = false;
iUART2.CTS.$used      = false;
iUART2.TX.$assign     = "ball.1";
iUART2.RX.$assign     = "ball.2";

/**
 * Pinmux solution for unlocked pins/peripherals. This ensures that minor changes to the automatic solver in a future
 * version of the tool will not impact the pinmux you originally saw.  These lines can be completely deleted in order to
 * re-solve from scratch.
 */
iGPIO1.$suggestSolution    = "GPIO";
iI2C1.$suggestSolution     = "I2C0";
iI2C1.SCL.$suggestSolution = "ball.3";
iI2C1.SDA.$suggestSolution = "ball.4";
iSPI1.$suggestSolution     = "SPI0";
iUART1.TX.$suggestSolution = "ball.55";
iUART1.RX.$suggestSolution = "ball.57";
iUART2.$suggestSolution    = "UART1";
